## Firmware/Kconfig.defconfig
```kconfig
if NULICE_LEFT

# Name must be less than 16 characters long!
config ZMK_KEYBOARD_NAME
    default "Nulice"

config ZMK_SPLIT_ROLE_CENTRAL
    default y

endif

if NULICE_LEFT || NULICE_RIGHT

config ZMK_SPLIT
    default y

endif
```

## Firmware/Kconfig.shield
```kconfig
# No whitespace after the comma or in your part name!
config NULICE_LEFT
    def_bool $(shields_list_contains,Nulice_left)

# No whitespace after the comma or in your part name!
config NULICE_RIGHT
    def_bool $(shields_list_contains,Nulice_right)
```
